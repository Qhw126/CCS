/**
 * @cliArgs --device "MSPM0G350X" --part "Default" --package "LQFP-64(PM)" --product "mspm0_sdk@2.11.00.07"
 * @versions {"tool":"1.26.2+4477"}
 */

/**
 * Import the modules used in this configuration.
 */
const GPIO   = scripting.addModule("/ti/driverlib/GPIO", {}, false);
const GPIO1  = GPIO.addInstance();
const GPIO2  = GPIO.addInstance();
const SYSCTL = scripting.addModule("/ti/driverlib/SYSCTL");

/**
 * Write custom configuration values to the imported modules.
 */
GPIO1.$name                   = "LED";
GPIO1.associatedPins.create(4);
GPIO1.associatedPins[0].$name = "PIN_0";
GPIO1.associatedPins[1].$name = "PIN_1";
GPIO1.associatedPins[2].$name = "PIN_2";
GPIO1.associatedPins[3].$name = "PIN_3";

const Board = scripting.addModule("/ti/driverlib/Board", {}, false);

GPIO2.$name                          = "GPIO_GRP_0";
GPIO2.associatedPins.create(4);
GPIO2.associatedPins[0].$name        = "AIN1";
GPIO2.associatedPins[0].initialValue = "SET";
GPIO2.associatedPins[0].assignedPort = "PORTA";
GPIO2.associatedPins[0].assignedPin  = "14";
GPIO2.associatedPins[1].$name        = "AIN2";
GPIO2.associatedPins[2].$name        = "BIN1";
GPIO2.associatedPins[3].$name        = "BIN2";

SYSCTL.forceDefaultClkConfig = true;

/**
 * Pinmux solution for unlocked pins/peripherals. This ensures that minor changes to the automatic solver in a future
 * version of the tool will not impact the pinmux you originally saw.  These lines can be completely deleted in order to
 * re-solve from scratch.
 */
GPIO1.associatedPins[0].pin.$suggestSolution = "PB13";
GPIO1.associatedPins[1].pin.$suggestSolution = "PB14";
GPIO1.associatedPins[2].pin.$suggestSolution = "PB15";
GPIO1.associatedPins[3].pin.$suggestSolution = "PB16";
Board.peripheral.$suggestSolution            = "DEBUGSS";
Board.peripheral.swclkPin.$suggestSolution   = "PA20";
Board.peripheral.swdioPin.$suggestSolution   = "PA19";
GPIO2.associatedPins[0].pin.$suggestSolution = "PA14";
GPIO2.associatedPins[1].pin.$suggestSolution = "PA12";
GPIO2.associatedPins[2].pin.$suggestSolution = "PA13";
GPIO2.associatedPins[3].pin.$suggestSolution = "PA15";
SYSCTL.peripheral.$suggestSolution           = "SYSCTL";
